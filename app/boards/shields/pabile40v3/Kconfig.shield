## app/boards/shields/pabile40v3/Kconfig.shield
```kconfig
# Copyright (c) 2025 The ZMK Contributors
# SPDX-License-Identifier: MIT

config SHIELD_PABILE40V3
	def_bool $(shields_list_contains,pabile40v3)
```
